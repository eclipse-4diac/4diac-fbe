/********************************************************************************
# Copyright (c) 2020, 2024 OFFIS e.V.
#
# This program and the accompanying materials are made available under the
# terms of the Eclipse Public License 2.0 which is available at
# http://www.eclipse.org/legal/epl-2.0.
#
# SPDX-License-Identifier: EPL-2.0
# 
# Contributors:
#    Jörg Walter - initial implementation
# *******************************************************************************/
/* Modified to insert Raspberry Pi specifics */
/* Default linker script, for normal executables */
/* Copyright (C) 2014-2019 Free Software Foundation, Inc.
   Copying and distribution of this script, with or without modification,
   are permitted in any medium without royalty provided the copyright
   notice and this notice are preserved.  */
OUTPUT_FORMAT("elf32-littlearm", "elf32-bigarm",
	      "elf32-littlearm")
OUTPUT_ARCH(arm)

_STACK_SIZE = DEFINED(_STACK_SIZE) ? _STACK_SIZE : 0x4000;
_HEAP_SIZE = DEFINED(_HEAP_SIZE) ? _HEAP_SIZE : 0x4000000; /* 64MB */

_ABORT_STACK_SIZE = DEFINED(_ABORT_STACK_SIZE) ? _ABORT_STACK_SIZE : 0x4000;
_SYSTEM_STACK_SIZE = DEFINED(_SYSTEM_STACK_SIZE) ? _SYSTEM_STACK_SIZE : 0x4000;
_SUPERVISOR_STACK_SIZE = DEFINED(_SUPERVISOR_STACK_SIZE) ? _SUPERVISOR_STACK_SIZE : 0x4000;
_IRQ_STACK_SIZE = DEFINED(_IRQ_STACK_SIZE) ? _IRQ_STACK_SIZE : 0x4000;
_FIQ_STACK_SIZE = DEFINED(_FIQ_STACK_SIZE) ? _FIQ_STACK_SIZE : 0x4000;
_UNDEF_STACK_SIZE = DEFINED(_UNDEF_STACK_SIZE) ? _UNDEF_STACK_SIZE : 0x4000;

MEMORY
{
	RAM		(rwx)	: ORIGIN = 0x0008000, LENGTH = 128M
}


ENTRY(__vector_table)
SEARCH_DIR("=/arm-none-eabi/lib"); SEARCH_DIR("=/usr/local/lib"); SEARCH_DIR("=/lib"); SEARCH_DIR("=/usr/lib");
SECTIONS
{
  /* Read-only sections, merged into text segment: */
  .init           :
  {
    __executable_start = .;
    *(.freertos_vectors)
    *(.vectors)
    *(.boot)
    KEEP (*(SORT_NONE(.init) SORT_NONE(.init.*)))
  } > RAM
  .text           :
  {
    *(.text.unlikely .text.*_unlikely .text.unlikely.*)
    *(.text.exit .text.exit.*)
    *(.text.startup .text.startup.*)
    *(.text.hot .text.hot.*)
    *(.text .stub .text.* .gnu.linkonce.t.*)
    /* .gnu.warning sections are handled specially by elf32.em.  */
    *(.gnu.warning)
    *(.glue_7t) *(.glue_7) *(.vfp11_veneer) *(.v4_bx)
  } > RAM
  .fini           :
  {
    KEEP (*(SORT_NONE(.fini)))
  } > RAM
  __etext = .;

	/*
	 * Data values which are preserved across reset
	 */
	.preserve (NOLOAD) : {
		PROVIDE(__preserve_start__ = .);
		KEEP(*(SORT_BY_NAME(.preserve.*)))
		KEEP(*(.preserve))
		PROVIDE(__preserve_end__ = .);
	} > RAM

  .rodata         : {
    *(.rdata)
    *(.rodata .rodata.* .gnu.linkonce.r.*)
    . = ALIGN(8);
	*(.srodata.cst16)
	*(.srodata.cst8)
	*(.srodata.cst4)
	*(.srodata.cst2)
	*(.srodata .srodata.*)
  } > RAM
  .rodata1        : { *(.rodata1) } > RAM
  .ARM.extab   : { *(.ARM.extab* .gnu.linkonce.armextab.*) } > RAM
   PROVIDE_HIDDEN (__exidx_start = .);
  .ARM.exidx   : { *(.ARM.exidx* .gnu.linkonce.armexidx.*) } > RAM
   PROVIDE_HIDDEN (__exidx_end = .);
  .eh_frame_hdr   : { *(.eh_frame_hdr) *(.eh_frame_entry .eh_frame_entry.*) } > RAM
  .eh_frame       : ONLY_IF_RO { KEEP (*(.eh_frame)) *(.eh_frame.*) } > RAM
  .gcc_except_table   : ONLY_IF_RO { *(.gcc_except_table .gcc_except_table.*) } > RAM
  .gnu_extab   : ONLY_IF_RO { *(.gnu_extab*) } > RAM
  /* These sections are generated by the Sun/Oracle C++ compiler.  */
  .exception_ranges   : ONLY_IF_RO { *(.exception_ranges*) } > RAM
  /* Adjust the address for the data segment.  We want to adjust up to
     the same address within the page on the next page up.  */
  . = ALIGN(CONSTANT (MAXPAGESIZE)) + (. & (CONSTANT (MAXPAGESIZE) - 1));
  /* Exception handling  */
  .eh_frame       : ONLY_IF_RW { KEEP (*(.eh_frame)) *(.eh_frame.*) } > RAM
  .gnu_extab      : ONLY_IF_RW { *(.gnu_extab) } > RAM
  .gcc_except_table   : ONLY_IF_RW { *(.gcc_except_table .gcc_except_table.*) } > RAM
  .exception_ranges   : ONLY_IF_RW { *(.exception_ranges*) } > RAM

  /* small data */
  .sdata : {
   __sdata_start = .;
   *(.sdata)
   *(.sdata.*)
   *(.gnu.linkonce.s.*)
   __sdata_end = .;
   } > RAM

   .sbss (NOLOAD) : {
   __sbss_start = .;
   *(.sbss)
   *(.sbss.*)
   *(.gnu.linkonce.sb.*)
   __sbss_end = .;
   } > RAM

  /* Thread Local Storage sections  */
  .tdata	  : ALIGN_WITH_INPUT
   {
     __tls_base = .;
     __tdata_source = .;
     *(.tdata .tdata.* .gnu.linkonce.td.*)
   } > RAM
  __tdata_size = . - __tdata_source;
  .tbss		  : {
     *(.tbss .tbss.* .gnu.linkonce.tb.*) *(.tcommon)
  } > RAM
  __tbss_size = . - __tdata_source - __tdata_size;
  .preinit_array    :
  {
    PROVIDE_HIDDEN (__preinit_array_start = .);
    KEEP (*(.preinit_array))
    PROVIDE_HIDDEN (__preinit_array_end = .);
  } > RAM
  .init_array    :
  {
    PROVIDE_HIDDEN (__init_array_start = .);
    KEEP (*(SORT_BY_INIT_PRIORITY(.init_array.*) SORT_BY_INIT_PRIORITY(.ctors.*)))
    KEEP (*(.init_array EXCLUDE_FILE (*crtbegin.o *crtbegin?.o *crtend.o *crtend?.o ) .ctors))
    PROVIDE_HIDDEN (__init_array_end = .);
  } > RAM
  .fini_array    :
  {
    PROVIDE_HIDDEN (__fini_array_start = .);
    KEEP (*(SORT_BY_INIT_PRIORITY(.fini_array.*) SORT_BY_INIT_PRIORITY(.dtors.*)))
    KEEP (*(.fini_array EXCLUDE_FILE (*crtbegin.o *crtbegin?.o *crtend.o *crtend?.o ) .dtors))
    PROVIDE_HIDDEN (__fini_array_end = .);
  } > RAM
  .ctors          :
  {
    /* gcc uses crtbegin.o to find the start of
       the constructors, so we make sure it is
       first.  Because this is a wildcard, it
       doesn't matter if the user does not
       actually link against crtbegin.o; the
       linker won't look for a file to match a
       wildcard.  The wildcard also means that it
       doesn't matter which directory crtbegin.o
       is in.  */
    KEEP (*crtbegin.o(.ctors))
    KEEP (*crtbegin?.o(.ctors))
    /* We don't want to include the .ctor section from
       the crtend.o file until after the sorted ctors.
       The .ctor section from the crtend file contains the
       end of ctors marker and it must be last */
    KEEP (*(EXCLUDE_FILE (*crtend.o *crtend?.o ) .ctors))
    KEEP (*(SORT(.ctors.*)))
    KEEP (*(.ctors))
  } > RAM
  .dtors          :
  {
    KEEP (*crtbegin.o(.dtors))
    KEEP (*crtbegin?.o(.dtors))
    KEEP (*(EXCLUDE_FILE (*crtend.o *crtend?.o ) .dtors))
    KEEP (*(SORT(.dtors.*)))
    KEEP (*(.dtors))
  } > RAM
  .data           : ALIGN_WITH_INPUT
  {
    __data_start = .;
    *(.data .data.* .gnu.linkonce.d.*)
    SORT(CONSTRUCTORS)
  } > RAM
  .data1          : { *(.data1) } > RAM
  __data_size = . - __data_start;
  . = .;
  __bss_start = .;
  .bss            :
  {
   *(.dynbss)
   *(.bss .bss.* .gnu.linkonce.b.*)
   *(COMMON)
   /* Align here to ensure that the .bss section occupies space up to
      _end.  Align after .bss to ensure correct alignment even if the
      .bss section disappears because there are no input sections.
      FIXME: Why do we need it? When there is no .bss section, we do not
      pad the .data section.  */
   . = ALIGN(. != 0 ? 32 / 8 : 1);
  } > RAM
  __bss_size = . - __bss_start;
  . = ALIGN(32 / 8);
  . = SEGMENT_START("ldata-segment", .);
  . = ALIGN(32 / 8);
  PROVIDE (_end = .);

.heap (NOLOAD) : {
   . = ALIGN(16);
   __heap_start = .;
   . += _HEAP_SIZE;
   __heap_end = .;
} > RAM

  .stack         (NOLOAD) :
  {
   . = ALIGN(16);
   _stack_end = .;
   . += _STACK_SIZE;
   . = ALIGN(16);
   __stack = .;
   . = ALIGN(16);
   . += _IRQ_STACK_SIZE;
   . = ALIGN(16);
   __irq_stack = .;
   . += _SUPERVISOR_STACK_SIZE;
   . = ALIGN(16);
   __supervisor_stack = .;
   . += _SYSTEM_STACK_SIZE;
   . = ALIGN(16);
   __system_stack = .;
   . += _ABORT_STACK_SIZE;
   . = ALIGN(16);
   __abort_stack = .;
   . += _FIQ_STACK_SIZE;
   . = ALIGN(16);
   __fiq_stack = .;
   . += _UNDEF_STACK_SIZE;
   . = ALIGN(16);
   __undef_stack = .;
    *(.stack)
  } > RAM

  /* Stabs debugging sections.  */
  .stab          0 : { *(.stab) } > RAM
  .stabstr       0 : { *(.stabstr) } > RAM
  .stab.excl     0 : { *(.stab.excl) } > RAM
  .stab.exclstr  0 : { *(.stab.exclstr) } > RAM
  .stab.index    0 : { *(.stab.index) } > RAM
  .stab.indexstr 0 : { *(.stab.indexstr) } > RAM
  .comment       0 : { *(.comment) } > RAM
  .gnu.build.attributes : { *(.gnu.build.attributes .gnu.build.attributes.*) } > RAM
  /* DWARF debug sections.
     Symbols in the DWARF debugging sections are relative to the beginning
     of the section so we begin them at 0.  */
  /* DWARF 1 */
  .debug          0 : { *(.debug) } > RAM
  .line           0 : { *(.line) } > RAM
  /* GNU DWARF 1 extensions */
  .debug_srcinfo  0 : { *(.debug_srcinfo) } > RAM
  .debug_sfnames  0 : { *(.debug_sfnames) } > RAM
  /* DWARF 1.1 and DWARF 2 */
  .debug_aranges  0 : { *(.debug_aranges) } > RAM
  .debug_pubnames 0 : { *(.debug_pubnames) } > RAM
  /* DWARF 2 */
  .debug_info     0 : { *(.debug_info .gnu.linkonce.wi.*) } > RAM
  .debug_abbrev   0 : { *(.debug_abbrev) } > RAM
  .debug_line     0 : { *(.debug_line .debug_line.* .debug_line_end) } > RAM
  .debug_frame    0 : { *(.debug_frame) } > RAM
  .debug_str      0 : { *(.debug_str) } > RAM
  .debug_loc      0 : { *(.debug_loc) } > RAM
  .debug_macinfo  0 : { *(.debug_macinfo) } > RAM
  /* SGI/MIPS DWARF 2 extensions */
  .debug_weaknames 0 : { *(.debug_weaknames) } > RAM
  .debug_funcnames 0 : { *(.debug_funcnames) } > RAM
  .debug_typenames 0 : { *(.debug_typenames) } > RAM
  .debug_varnames  0 : { *(.debug_varnames) } > RAM
  /* DWARF 3 */
  .debug_pubtypes 0 : { *(.debug_pubtypes) } > RAM
  .debug_ranges   0 : { *(.debug_ranges) } > RAM
  /* DWARF Extension.  */
  .debug_macro    0 : { *(.debug_macro) } > RAM
  .debug_addr     0 : { *(.debug_addr) } > RAM
  .ARM.attributes 0 : { KEEP (*(.ARM.attributes)) KEEP (*(.gnu.attributes)) } > RAM
.note.gnu.arm.ident 0 : { KEEP (*(.note.gnu.arm.ident)) } > RAM
/* This section contains data that is not initialised during load
   *or* application reset.  */
 .noinit (NOLOAD) :
 {
   . = ALIGN(2);
   /* PROVIDE (__noinit_start = .); */
   *(.noinit)
   . = ALIGN(2);
   /* PROVIDE (__noinit_end = .); */
 } > RAM
  /DISCARD/ : { *(.note.GNU-stack) *(.gnu_debuglink) *(.gnu.lto_*) }
}
